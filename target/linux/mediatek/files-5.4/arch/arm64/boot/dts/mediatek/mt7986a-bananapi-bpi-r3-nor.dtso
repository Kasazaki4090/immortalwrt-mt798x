/dts-v1/;
/plugin/;
#include "mt7986-spim-nor-partition.dtsi"
/ {
	model = "Bananapi BPI-R3";
	compatible = "bananapi,bpi-r3-nand", "mediatek,mt7986a";
	chosen {
		bootargs = "console=ttyS0,115200n1 loglevel=8  \
		earlycon=uart8250,mmio32,0x11002000";
	};
};
